#include <Wire.h>
#include <WiFi.h>
#include <Adafruit_GFX.h>
#include <Adafruit_SSD1306.h>
#include <IRremoteESP8266.h>
#include <IRrecv.h>
#include <IRutils.h>
#include <IRsend.h>

#define SCREEN_WIDTH 128
#define SCREEN_HEIGHT 64

#define OLED_SDA 33
#define OLED_SCL 32

#define TOUCH_PIN1 14
#define TOUCH_PIN2 27
#define TOUCH_PIN3 26
#define TOUCH_PIN4 25

#define IR_PIN 35

#define IR_LED 23


Adafruit_SSD1306 display(SCREEN_WIDTH, SCREEN_HEIGHT, &Wire, -1);

IRrecv irrecv(IR_PIN);
decode_results results;

IRsend irsend(IR_LED);

const unsigned char startup_logo [] PROGMEM = {
  0xFF, 0xFF, 0xFF, 0xFF, 0xFF, 0xFF, 0xFF, 0xFF, 0xFF, 0xFF, 0xFF, 0xFF, 0xFF, 0xFF, 0xFF, 0xFF,
  0xFF, 0xFF, 0xFF, 0xFF, 0xFF, 0xFF, 0xFF, 0xFF, 0xFF, 0xFF, 0xFF, 0xFF, 0xFF, 0xFF, 0xFF, 0xFF,
  0xFF, 0xFF, 0xFF, 0xFF, 0xFF, 0xFF, 0xFF, 0xFF, 0xFF, 0xFF, 0xFF, 0xFF, 0xFF, 0xFF, 0xFF, 0xFF,
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  0xFF, 0xFF, 0xFF, 0xFF, 0xFF, 0xFF, 0xFF, 0xFF, 0xFF, 0xFF, 0xFF, 0xFF, 0xFF, 0xFF, 0xFF, 0xFF
};

int ssid_count = 0;
int i = 0;

int selected_ssid = 0;
int ssid_at_top = 0;
const int max_visible_ssid = 3;

String entered_wifi_password = "";

char current_screen[20] = "home";
char menu_selection[20] = "settings";
char settings_selection[20] = "wifi";
char wifi_status[20] = "scanning";
char wifi_connection[20] = "disconnected";

const char* ares_text = "ARES";
int16_t offsetx_ares_text, offsety_ares_text;
uint16_t textWidth_ares_text, textHeight_ares_text;

const char* time_text = "00:00:00";
int16_t offsetx_time_text, offsety_time_text;
uint16_t textWidth_time_text, textHeight_time_text;

const char* settings_text = "Settings";
int16_t offsetx_settings_text, offsety_settings_text;
uint16_t textWidth_settings_text, textHeight_settings_text;

const char* wifi_text = "WiFi";
int16_t offsetx_wifi_text, offsety_wifi_text;
uint16_t textWidth_wifi_text, textHeight_wifi_text;

char wifi_ssid_text[20] = "ssid";
int16_t offsetx_wifi_ssid_text, offsety_wifi_ssid_text;
uint16_t textWidth_wifi_ssid_text, textHeight_wifi_ssid_text;

char IR_Number(uint32_t code) {

  if (code == 0xFFA25D) return '1';
  if (code == 0xFF629D) return '2';
  if (code == 0xFFE21D) return '3';
  if (code == 0xFF22DD) return '4';
  if (code == 0xFF02FD) return '5';
  if (code == 0xFFC23D) return '6';
  if (code == 0xFFE01F) return '7';
  if (code == 0xFFA857) return '8';
  if (code == 0xFF906F) return '9';
  if (code == 0xFF9867) return '0';

  return '\0';
}

void Touchpin_Input_Read() {
  int touchpin1_state = digitalRead(TOUCH_PIN1);
  int touchpin2_state = digitalRead(TOUCH_PIN2);
  int touchpin3_state = digitalRead(TOUCH_PIN3);
  int touchpin4_state = digitalRead(TOUCH_PIN4);

  if (touchpin1_state == HIGH) {
    Serial.println("Channel 1 triggered!");
    if (strcmp(current_screen, "menu") == 0) {
      if (strcmp(menu_selection, "apps") == 0) {
        strcpy(menu_selection, "settings");
        Menu_Screen();
      }
    } else if (strcmp(current_screen, "settings") == 0) {
      if (strcmp(settings_selection, "bluetooth") == 0) {
        strcpy(settings_selection, "wifi");
        Settings_Screen();
      }
    } else if (strcmp(current_screen, "wifi_settings") == 0) {
      if (selected_ssid > 0) {
        selected_ssid--;
        Wifi_Settings_Screen();
      }
    }
    delay(500);
  }
  if (touchpin2_state == HIGH) {
    Serial.println("Channel 2 triggered!");
    if (strcmp(current_screen, "menu") == 0) {
      if (strcmp(menu_selection, "settings") == 0) {
        strcpy(menu_selection, "apps");
        Menu_Screen();
      }
    } else if (strcmp(current_screen, "settings") == 0) {
      if (strcmp(settings_selection, "wifi") == 0) {
        strcpy(settings_selection, "bluetooth");
        Settings_Screen();
      }
    } else if (strcmp(current_screen, "wifi_settings") == 0) {
      if (selected_ssid < ssid_count - 1) {
        selected_ssid++;
        Wifi_Settings_Screen();
      }
    }
    delay(500);
  }

  if (touchpin3_state == HIGH) {
    Serial.println("Channel 3 triggered!");
    if (strcmp(current_screen, "menu") == 0) {
      if (strcmp(menu_selection, "settings") == 0) {
        Settings_Screen();
      }
    } else if (strcmp(current_screen, "settings") == 0) {
      if (strcmp(settings_selection, "wifi") == 0) {
        strcpy(wifi_status, "scanning");
        Wifi_Settings_Screen();
      }
    } else if (strcmp(current_screen, "wifi_settings") == 0) {
      if (ssid_count > 0) {
        Serial.print("Selected WiFi: ");
        Serial.println(WiFi.SSID(selected_ssid));
        strcpy(wifi_ssid_text, WiFi.SSID(selected_ssid).c_str());
        Selected_WiFi_Screen();
      }
    }
    delay(500);
  }
  if (touchpin4_state == HIGH) {
    Serial.println("Channel 4 triggered!");

    if (strcmp(current_screen, "home") == 0) {
      Menu_Screen();
    } else if (strcmp(current_screen, "menu") == 0) {
      Home_Screen();
    } else if (strcmp(current_screen, "settings") == 0) {
      Menu_Screen();
    } else if (strcmp(current_screen, "wifi_settings") == 0) {
      Settings_Screen();
    } else if (strcmp(current_screen, "selected_wifi") == 0) {
      entered_wifi_password = "";
      Wifi_Settings_Screen();
    }
    delay(500);
  }
}

void Home_Screen() {
  display.clearDisplay();
  display.setTextSize(2);
  display.setTextColor(SSD1306_WHITE);
  display.getTextBounds(ares_text, 0, 0, &offsetx_ares_text, &offsety_ares_text, &textWidth_ares_text, &textHeight_ares_text);

  int x_ares_text = (SCREEN_WIDTH - textWidth_ares_text) / 2 - offsetx_ares_text;
  int y_ares_text = (SCREEN_HEIGHT - textHeight_ares_text) / 2 - offsety_ares_text;

  display.setCursor(x_ares_text, y_ares_text);
  display.print(ares_text);

  display.setTextSize(1);
  display.getTextBounds(time_text, 0, 0, &offsetx_time_text, &offsety_time_text, &textWidth_time_text, &textHeight_time_text);
  
  int x_time_text = (SCREEN_WIDTH - textWidth_time_text) / 2 - offsetx_time_text;

  display.setCursor(x_time_text, 0);
  display.print(time_text);
  display.display();
  strcpy(current_screen, "home");
}


void Menu_Screen() {
  display.clearDisplay();
  display.setTextSize(1);
  display.setTextColor(SSD1306_WHITE);
  display.setCursor(0, 0);
  if (strcmp(menu_selection, "settings") == 0) {
    display.print("> Settings");
  } else {
    display.print("  Settings");
  }

  display.setCursor(0, 15);
  if (strcmp(menu_selection, "apps") == 0) {
    display.print("> Apps");
  } else {
    display.print("  Apps");
  }

  
  display.display();
  strcpy(current_screen, "menu");
}


void Settings_Screen() {
  display.clearDisplay();
  display.setTextSize(1);
  display.setTextColor(SSD1306_WHITE);

  display.getTextBounds(settings_text, 0, 0, &offsetx_settings_text, &offsety_settings_text, &textWidth_settings_text, &textHeight_settings_text);
  
  int x_settings_text = (SCREEN_WIDTH - textWidth_settings_text) / 2 - offsetx_settings_text;

  display.setCursor(x_settings_text, 0);
  display.print(settings_text);

  display.setCursor(0, 15);
  if (strcmp(settings_selection, "wifi") == 0) {
    display.print("> WiFi");
  } else {
    display.print("  WiFi");
  }

  display.setCursor(0, 30);
  if (strcmp(settings_selection, "bluetooth") == 0) {
    display.print("> Bluetooth");
  } else {
    display.print("  Bluetooth");
  }

  display.display();
  strcpy(current_screen, "settings");
}

int scanWifi() {
  WiFi.mode(WIFI_STA);
  WiFi.disconnect();
  ssid_count = WiFi.scanNetworks();
  strcpy(wifi_status, "scanned");
  Wifi_Settings_Screen();
  return ssid_count;
}

void Wifi_Settings_Screen() {
  int ssid_gap_y = 15;
  display.clearDisplay();
  display.setTextSize(1);
  display.setTextColor(SSD1306_WHITE);

  display.getTextBounds(wifi_text, 0, 0, &offsetx_wifi_text, &offsety_wifi_text, &textWidth_wifi_text, &textHeight_wifi_text);
  
  int x_wifi_text = (SCREEN_WIDTH - textWidth_wifi_text) / 2 - offsetx_wifi_text;

  display.setCursor(x_wifi_text, 0);
  display.print(wifi_text);

  display.setCursor(0, 15);
  if (strcmp(wifi_status, "scanning") == 0) {
    display.print("Scanning...");
    display.display();
    scanWifi();
  } else if (strcmp(wifi_status, "scanned") == 0) {

  }

  display.setCursor(0, 15);

  if (ssid_count == 0) {
    display.println("No networks found");
  } else {
    if (selected_ssid < ssid_at_top) {
      ssid_at_top = selected_ssid;
    } else if (selected_ssid >= ssid_at_top + max_visible_ssid) {
      ssid_at_top = selected_ssid - max_visible_ssid + 1;
    }

    for (i = ssid_at_top; i < ssid_count && i < ssid_at_top + max_visible_ssid; ++i) {
      display.setCursor(0, ssid_gap_y);

      if (i == selected_ssid) {
        display.print("> ");
      } else {
        display.print("  ");
      }

      display.println(WiFi.SSID(i));
      ssid_gap_y += 15;
      delay(10);
    } 
  }

  display.display();
  
  strcpy(current_screen, "wifi_settings");
}

void Selected_WiFi_Screen() {
  display.clearDisplay();
  display.setTextSize(1);
  display.setTextColor(SSD1306_WHITE);

  display.getTextBounds(wifi_ssid_text, 0, 0, &offsetx_wifi_ssid_text, &offsety_wifi_ssid_text, &textWidth_wifi_ssid_text, &textHeight_wifi_ssid_text);
  
  int x_wifi_ssid_text = (SCREEN_WIDTH - textWidth_wifi_ssid_text) / 2 - offsetx_wifi_ssid_text;

  display.setCursor(x_wifi_ssid_text, 0);
  display.print(wifi_ssid_text);

  display.drawRect(0, 18, 128, 25, SSD1306_WHITE);

  display.setCursor(4, 27);

  // Show entered password
  display.print(entered_wifi_password);
  display.display();

  strcpy(current_screen, "selected_wifi");
}

void Connect_WiFi() {

  Serial.print("Connecting to: ");
  Serial.println(WiFi.SSID(selected_ssid));

  WiFi.begin(WiFi.SSID(selected_ssid).c_str(), entered_wifi_password.c_str());

  unsigned long startTime = millis();

  while (WiFi.status() != WL_CONNECTED && millis() - startTime < 10000) {
    display.clearDisplay();
    display.setTextSize(1);
    display.setTextColor(SSD1306_WHITE);
    
    display.getTextBounds(wifi_ssid_text, 0, 0, &offsetx_wifi_ssid_text, &offsety_wifi_ssid_text, &textWidth_wifi_ssid_text, &textHeight_wifi_ssid_text);
    int x_wifi_ssid_text = (SCREEN_WIDTH - textWidth_wifi_ssid_text) / 2 - offsetx_wifi_ssid_text;
    
    display.setCursor(x_wifi_ssid_text, 0);
    display.print(wifi_ssid_text);
    
    display.setTextSize(2);
    display.setCursor(0, 30);
    display.println("CONNECTING..");
    display.display();
    delay(500);
    }

  if (WiFi.status() == WL_CONNECTED) {

    Serial.println("Connected!");
    Serial.print("IP Address: ");
    Serial.println(WiFi.localIP());
    strcpy(wifi_connection, "connected");
    entered_wifi_password = "";
    WiFi_Connection_Success_Screen();
  } else {

    Serial.println("Wrong password / connection failed");
    WiFi.disconnect();
    strcpy(wifi_connection, "disconnected");
    entered_wifi_password = "";
    WiFi_Connection_Failed_Screen();
  }
}

void WiFi_Connection_Success_Screen() {
  display.clearDisplay();
  display.setTextSize(1);
  display.setTextColor(SSD1306_WHITE);

  display.getTextBounds(wifi_ssid_text, 0, 0, &offsetx_wifi_ssid_text, &offsety_wifi_ssid_text, &textWidth_wifi_ssid_text, &textHeight_wifi_ssid_text);
  
  int x_wifi_ssid_text = (SCREEN_WIDTH - textWidth_wifi_ssid_text) / 2 - offsetx_wifi_ssid_text;

  display.setCursor(x_wifi_ssid_text, 0);
  display.print(wifi_ssid_text);

  display.setTextSize(2);
  display.setCursor(0, 30);
  display.print("CONNECTED");
  strcpy(current_screen, "wifi_connected");
  display.display();
  delay(1500);
  Wifi_Settings_Screen();
}

void WiFi_Connection_Failed_Screen() {
  display.clearDisplay();
  display.setTextSize(1);
  display.setTextColor(SSD1306_WHITE);

  display.getTextBounds(wifi_ssid_text, 0, 0, &offsetx_wifi_ssid_text, &offsety_wifi_ssid_text, &textWidth_wifi_ssid_text, &textHeight_wifi_ssid_text);
  
  int x_wifi_ssid_text = (SCREEN_WIDTH - textWidth_wifi_ssid_text) / 2 - offsetx_wifi_ssid_text;

  display.setCursor(x_wifi_ssid_text, 0);
  display.print(wifi_ssid_text);

  display.setTextSize(2);
  display.setCursor(0, 30);
  display.println("COULD'NT");
  display.println("CONNECT");
  strcpy(current_screen, "wifi_not_connected");
  display.display();
  delay(1500);
  Wifi_Settings_Screen();
}

void setup() {

  Serial.begin(115200); 

  Wire.begin(OLED_SDA, OLED_SCL);

  display.begin(SSD1306_SWITCHCAPVCC, 0x3C);

  pinMode(TOUCH_PIN1, INPUT);
  pinMode(TOUCH_PIN2, INPUT);
  pinMode(TOUCH_PIN3, INPUT);
  pinMode(TOUCH_PIN4, INPUT);

  irrecv.enableIRIn();

  pinMode(IR_LED, OUTPUT);
  irsend.begin();

  Serial.println("IR Transmitter Test");

  display.clearDisplay();

  // Startup
  display.drawBitmap(0, 0, startup_logo, 128, 64, SSD1306_WHITE);
  display.display();

  delay(2500);
  display.clearDisplay();
  // Startup

  //Home Screen
  Home_Screen();
  // Home Screen

}

void loop() {
  Touchpin_Input_Read();

  if (irrecv.decode(&results)) {
    Serial.println(resultToHumanReadableBasic(&results));
    if (strcmp(current_screen, "selected_wifi") == 0) {

      char number = IR_Number(results.value);

      if (number != '\0') {

        entered_wifi_password += number;

        Selected_WiFi_Screen();
      }

      if (results.value == 0xFF38C7) {
        Serial.print("Entered password: ");
        Serial.println(entered_wifi_password);
        Connect_WiFi();
      }
    }

    irrecv.resume();
  }

  irsend.sendNEC(0xFFA25D, 32);

  Serial.println("Sent: 0xFFA25D");

}